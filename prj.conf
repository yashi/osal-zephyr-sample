## CMakeLists.txt
```
# SPDX-License-Identifier: Apache-2.0

cmake_minimum_required(VERSION 3.20.0)

find_package(Zephyr REQUIRED HINTS $ENV{ZEPHYR_BASE})
project(hello_osal)

target_sources(app PRIVATE src/main.c)
```

## west.yml
```
manifest:

  projects:
    - name: zephyr
      url: https://github.com/zephyrproject-rtos/zephyr
      revision: main
      path: zephyr
      west-commands: scripts/west-commands.yml
      import:
        name-allowlist:
          - cmsis
          - cmsis_6

    - name: osal
      url: https://github.com/yashi/osal-zephyr
      revision: add-zephyr-support
      path: modules/lib/osal
```

## prj.conf
```kconfig
CONFIG_CFS_OSAL=y
```

## src/main.c
```c
/*
 * Copyright (c) 2025 Space Cubics
 *
 * SPDX-License-Identifier: Apache-2.0
 */

#include <stdio.h>
#include "osapi.h"

int main(void)
{
	printf("Hello cFS OSAL!\n");

	OS_Application_Startup();

	return 0;
}
```
